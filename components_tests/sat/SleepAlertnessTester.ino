/*
 * ═══════════════════════════════════════════════════════════
 *  SLEEPWATCH — ESP32-S3
 *  Cognitive alertness test + on-device ML sleep scoring
 *
 *  Arduino IDE settings:
 *    Board          → ESP32S3 Dev Module
 *    PSRAM          → OPI PSRAM
 *    CPU Speed      → 240 MHz
 *    Partition      → Huge APP (3MB No OTA)
 *
 *  Libraries (Library Manager):
 *    ESPAsyncWebServer   by me-no-dev
 *    AsyncTCP            by me-no-dev
 *
 *  Extra file in THIS sketch folder (from Colab):
 *    sleep_scorer.h      ← m2cgen export, drop & done
 * ═══════════════════════════════════════════════════════════
 */

#include <WiFi.h>
#include <ESPAsyncWebServer.h>
#include "sleep_scorer.h"   // ← generated by Colab

// ── AP credentials (ESP32-S3 acts as the hotspot) ────────────
const char* AP_SSID = "nodero";
const char* AP_PASS = "nodero123";   // min 8 chars ✓

AsyncWebServer server(80);

// ═══════════════════════════════════════════════════════════
//  QUESTION BANK
//  3 pools: Easy / Medium / Hard  — 3 questions drawn per round
// ═══════════════════════════════════════════════════════════
struct Q { const char* text; const char* answer; uint16_t budget; };

const Q EASY[] = {
  {"What is 4 + 7?",                              "11",      7000},
  {"What is 9 - 3?",                              "6",       7000},
  {"Type the word: CLOUD",                        "cloud",   6000},
  {"Which is odd: Cat, Dog, Table, Bird?",        "table",   9000},
  {"Complete: 2, 4, 6, ___",                      "8",       7000},
  {"Sun rises in the EAST or WEST?",              "east",    7000},
  {"What is 5 x 3?",                              "15",      8000},
  {"Type the word: RIVER",                        "river",   6000},
  {"What comes after Sunday?",                    "monday",  7000},
  {"What is 20 / 4?",                             "5",       8000},
};
const Q MEDIUM[] = {
  {"What is 13 x 7?",                             "91",      11000},
  {"Spell backwards: CAT",                        "tac",     9000},
  {"Next: 2, 4, 8, 16, ___",                      "32",      11000},
  {"Opposite of ANCIENT?",                        "modern",  9000},
  {"Repeat this: 7 3 9",                          "7 3 9",   10000},
  {"Odd one out: Tennis, Football, Bat, Cricket?","bat",     11000},
  {"What is 8 squared?",                          "64",      11000},
  {"Spell backwards: DOG",                        "god",     9000},
  {"What is 144 / 12?",                           "12",      11000},
  {"Opposite of SHALLOW?",                        "deep",    9000},
};
const Q HARD[] = {
  {"What is 17 x 13?",                                "221",       14000},
  {"Spell backwards: SLEEP",                          "peels",     12000},
  {"Next: 1, 1, 2, 3, 5, 8, ___",                    "13",        12000},
  {"Odd one out: Oxygen, Nitrogen, Iron, Helium?",    "iron",      13000},
  {"Repeat this: 4 7 2 9 1",                          "4 7 2 9 1", 13000},
  {"Next: 3, 9, 27, 81, ___",                         "243",       13000},
  {"What is 256 / 16?",                               "16",        14000},
  {"Odd one out: Jupiter, Mars, Moon, Saturn?",       "moon",      13000},
  {"Synonym of FATIGUED?",                            "tired",     12000},
  {"What is 12 squared minus 44?",                    "100",       14000},
};
#define POOL_SZ 10
#define ROUNDS   3
#define QS_PER   3

// ═══════════════════════════════════════════════════════════
//  SESSION
// ═══════════════════════════════════════════════════════════
struct Ans { bool ok; uint32_t ms; };

struct Session {
  bool    active, done;
  uint8_t round, qi;
  uint8_t idx[ROUNDS][QS_PER];
  Ans     ans[ROUNDS][QS_PER];
  uint32_t qStart;
  float   score;
};
Session ses;

void shuffle(uint8_t* a, uint8_t n) {
  for (int i = n-1; i > 0; i--) { uint8_t j=random(i+1), t=a[i]; a[i]=a[j]; a[j]=t; }
}
void pickRound(uint8_t r) {
  uint8_t pool[POOL_SZ]; for (uint8_t i=0;i<POOL_SZ;i++) pool[i]=i;
  shuffle(pool, POOL_SZ);
  for (uint8_t i=0;i<QS_PER;i++) ses.idx[r][i]=pool[i];
}
const Q& curQ() {
  uint8_t i = ses.idx[ses.round][ses.qi];
  return ses.round==0 ? EASY[i] : ses.round==1 ? MEDIUM[i] : HARD[i];
}
bool checkAns(const String& raw) {
  String u=raw; u.trim(); u.toLowerCase();
  String e=String(curQ().answer); e.toLowerCase();
  return u==e;
}

// ═══════════════════════════════════════════════════════════
//  FEATURE EXTRACTION + ML SCORING
// ═══════════════════════════════════════════════════════════
const char* verdict(float s) {
  if (s >= 85) return "FULLY ALERT";
  if (s >= 68) return "MILDLY DROWSY";
  if (s >= 50) return "MODERATELY SLEEPY";
  if (s >= 30) return "SEVERELY IMPAIRED";
  return "CRITICALLY SLEEP-DEPRIVED";
}

float runScorer() {
  double r_acc[3]={}, r_spd[3]={};
  double all_times[9]; uint8_t ti=0;

  for (uint8_t r=0;r<ROUNDS;r++) {
    uint8_t ok=0; double spd_sum=0;
    for (uint8_t q=0;q<QS_PER;q++) {
      if (ses.ans[r][q].ok) ok++;
      spd_sum    += ses.ans[r][q].ms;
      all_times[ti++] = ses.ans[r][q].ms;
    }
    r_acc[r] = ok / (double)QS_PER;
    r_spd[r] = spd_sum / QS_PER;
  }

  // Response variance — std dev of all 9 response times
  double mean=0;
  for (uint8_t i=0;i<9;i++) mean+=all_times[i];
  mean/=9;
  double var=0;
  for (uint8_t i=0;i<9;i++) var+=(all_times[i]-mean)*(all_times[i]-mean);
  double stddev = sqrt(var/9.0);

  // Feature vector — must match training order in Colab notebook
  double feats[9] = {
    r_acc[0], r_acc[1], r_acc[2],        // accuracy per round
    r_spd[0], r_spd[1], r_spd[2],        // avg response time per round (ms)
    r_spd[2] - r_spd[0],                 // speed_trend  (+ = slowing = bad)
    r_acc[2] - r_acc[0],                 // acc_trend    (- = dropping = bad)
    stddev                                // response_variance (ms)
  };

  Serial.printf("[ML] acc=[%.2f %.2f %.2f] spd=[%.0f %.0f %.0f] "
                "spd_trend=%.0f acc_trend=%.2f var=%.0f\n",
    feats[0],feats[1],feats[2],feats[3],feats[4],
    feats[5],feats[6],feats[7],feats[8]);

  float s = score_session(feats);   // ← m2cgen generated function
  Serial.printf("[ML] Score: %.1f — %s\n", s, verdict(s));
  return s;
}

// ═══════════════════════════════════════════════════════════
//  WEB UI
// ═══════════════════════════════════════════════════════════
const char PAGE[] PROGMEM = R"HTML(
<!DOCTYPE html><html lang="en"><head>
<meta charset="UTF-8"><meta name="viewport" content="width=device-width,initial-scale=1">
<title>SleepWatch</title>
<style>
@import url('https://fonts.googleapis.com/css2?family=Share+Tech+Mono&family=Orbitron:wght@700;900&display=swap');
:root{--bg:#07090a;--surf:#0d1214;--bord:#1a2830;--grn:#3ddc84;--amb:#f5a623;--red:#ff453a;--muted:#3d5a4a;--txt:#b8d4c0;--sub:#476052;}
*{box-sizing:border-box;margin:0;padding:0}
body{background:var(--bg);color:var(--txt);font-family:'Share Tech Mono',monospace;
  min-height:100vh;display:flex;flex-direction:column;align-items:center;padding:20px 14px 48px;
  background-image:radial-gradient(ellipse 60% 40% at 15% 5%,rgba(61,220,132,.05),transparent),
    radial-gradient(ellipse 60% 40% at 85% 95%,rgba(245,166,35,.04),transparent);}
header{width:100%;max-width:560px;text-align:center;padding-bottom:14px;
  border-bottom:1px solid var(--bord);margin-bottom:20px;}
.logo{font-family:'Orbitron',sans-serif;font-weight:900;font-size:clamp(16px,4vw,22px);
  letter-spacing:.3em;color:var(--grn);}
.logo b{color:var(--amb);}
.sub{font-size:10px;color:var(--sub);letter-spacing:.18em;margin-top:4px;}
@keyframes blink{0%,100%{opacity:1}50%{opacity:.25}}
.dot{display:inline-block;width:6px;height:6px;border-radius:50%;
  background:var(--grn);margin-right:5px;animation:blink 1.4s infinite;}
.prog-wrap{width:100%;max-width:560px;height:2px;background:var(--bord);
  border-radius:1px;margin-bottom:20px;}
.prog{height:100%;border-radius:1px;background:var(--amb);
  box-shadow:0 0 6px var(--amb);transition:width .4s ease;width:0%}
.card{width:100%;max-width:560px;background:var(--surf);
  border:1px solid var(--bord);border-radius:3px;padding:22px 20px;position:relative;overflow:hidden;}
.card::after{content:'';position:absolute;top:0;left:10%;right:10%;height:1px;
  background:linear-gradient(90deg,transparent,rgba(61,220,132,.35),transparent);}
@keyframes scan{from{transform:translateY(-100%)}to{transform:translateY(700%)}}
.scan{position:absolute;inset:0 0 auto;height:1px;
  background:rgba(61,220,132,.06);animation:scan 6s linear infinite;pointer-events:none;}
.screen{display:none}.screen.on{display:block}
.title{font-family:'Orbitron',sans-serif;font-size:18px;font-weight:700;color:var(--grn);margin-bottom:8px;}
.desc{font-size:12px;line-height:1.8;margin-bottom:18px;}
.meta{display:grid;grid-template-columns:1fr 1fr;gap:8px;margin-bottom:20px;}
.meta-cell{background:var(--bg);border:1px solid var(--bord);border-radius:3px;padding:10px;}
.meta-label{font-size:9px;color:var(--sub);letter-spacing:.12em;margin-bottom:3px;}
.meta-val{font-size:14px;color:var(--amb);font-family:'Orbitron',sans-serif;}
.meta-val.sm{font-size:11px;color:var(--txt);font-family:'Share Tech Mono',monospace;}
.round-tag{font-size:10px;letter-spacing:.2em;color:var(--sub);margin-bottom:4px;}
.diff{display:inline-block;font-size:9px;padding:2px 7px;border-radius:2px;margin-left:6px;vertical-align:middle;}
.d0{background:rgba(61,220,132,.13);color:var(--grn);}
.d1{background:rgba(245,166,35,.13);color:var(--amb);}
.d2{background:rgba(255,69,58,.13);color:var(--red);}
.q-text{font-family:'Orbitron',sans-serif;font-size:clamp(14px,3.5vw,17px);font-weight:700;
  color:#e8f0ec;line-height:1.45;margin-bottom:16px;}
.timer-row{display:flex;align-items:center;gap:8px;margin-bottom:12px;}
.t-label{font-size:9px;letter-spacing:.1em;color:var(--sub);}
.t-bar{flex:1;height:3px;background:var(--bord);border-radius:2px;overflow:hidden;}
.t-fill{height:100%;border-radius:2px;transition:width .08s linear,background .25s;}
.t-val{font-size:12px;min-width:36px;text-align:right;}
.feedback{padding:8px 12px;border-radius:3px;font-size:12px;margin-bottom:11px;display:none;}
.f-ok{background:rgba(61,220,132,.09);color:var(--grn);border:1px solid rgba(61,220,132,.25);}
.f-bad{background:rgba(255,69,58,.09);color:var(--red);border:1px solid rgba(255,69,58,.25);}
input{width:100%;background:var(--bg);border:1px solid var(--muted);border-radius:3px;
  color:var(--grn);font-family:'Share Tech Mono',monospace;font-size:19px;
  padding:12px 14px;outline:none;transition:border-color .2s;margin-bottom:12px;letter-spacing:.04em;}
input:focus{border-color:var(--amb);}
input.ok{border-color:var(--grn);background:rgba(61,220,132,.04);}
input.bad{border-color:var(--red);background:rgba(255,69,58,.04);}
button{width:100%;padding:12px;font-family:'Orbitron',sans-serif;font-size:11px;font-weight:700;
  letter-spacing:.18em;border:none;border-radius:3px;cursor:pointer;transition:all .18s;}
.btn-main{background:var(--amb);color:#07090a;}
.btn-main:hover{background:#ffc040;box-shadow:0 0 14px rgba(245,166,35,.3);}
.btn-main:disabled{background:var(--muted);cursor:not-allowed;box-shadow:none;}
.rs-score{font-family:'Orbitron',sans-serif;font-size:52px;font-weight:900;
  text-align:center;line-height:1;margin:10px 0 2px;}
.rs-label{font-size:10px;letter-spacing:.15em;color:var(--sub);text-align:center;margin-bottom:16px;}
.q-list{list-style:none;margin-bottom:16px;}
.q-list li{display:flex;align-items:center;justify-content:space-between;
  padding:7px 0;border-bottom:1px solid var(--bord);font-size:12px;}
.q-list li:last-child{border-bottom:none;}
.q-txt{flex:1;padding-right:10px;color:var(--txt);}
.badge{font-size:10px;padding:2px 8px;border-radius:2px;}
.b-ok{background:rgba(61,220,132,.13);color:var(--grn);}
.b-bad{background:rgba(255,69,58,.13);color:var(--red);}
.q-ms{color:var(--sub);min-width:38px;text-align:right;margin-left:6px;}
.final-wrap{text-align:center;padding:12px 0 20px;}
.score-label{font-size:10px;letter-spacing:.2em;color:var(--sub);margin-bottom:4px;}
.score-big{font-family:'Orbitron',sans-serif;font-size:clamp(68px,18vw,92px);font-weight:900;line-height:1;}
.verdict{font-family:'Orbitron',sans-serif;font-size:clamp(12px,3vw,15px);font-weight:700;
  letter-spacing:.1em;margin-top:6px;margin-bottom:20px;}
.ml-tag{display:inline-block;font-size:9px;padding:3px 10px;border-radius:2px;margin-bottom:14px;
  border:1px solid rgba(61,220,132,.25);color:var(--grn);background:rgba(61,220,132,.06);letter-spacing:.12em;}
.breakdown .row{display:flex;justify-content:space-between;padding:6px 0;
  border-bottom:1px solid var(--bord);font-size:12px;}
.breakdown .row:last-child{border-bottom:none;}
.breakdown .row.total{border-top:1px solid var(--amb);margin-top:3px;padding-top:10px;}
.row-label{color:var(--sub);}
.row-val{color:var(--amb);}
</style>
</head>
<body>
<header>
  <div class="logo">SLEEP<b>WATCH</b></div>
  <div class="sub"><span class="dot"></span>ON-DEVICE ML ALERTNESS SCORER</div>
</header>
<div class="prog-wrap"><div class="prog" id="prog"></div></div>

<div class="card">
  <div class="scan"></div>

  <!-- START -->
  <div class="screen on" id="s0">
    <div class="title">ALERTNESS TEST</div>
    <div class="desc">3 rounds of adaptive cognitive questions. Your speed, accuracy, and response patterns are fed into a trained ML model running on this device to compute your sleep score.</div>
    <div class="meta">
      <div class="meta-cell"><div class="meta-label">ROUNDS</div><div class="meta-val">3</div></div>
      <div class="meta-cell"><div class="meta-label">Q PER ROUND</div><div class="meta-val">3</div></div>
      <div class="meta-cell"><div class="meta-label">SCORING</div><div class="meta-val sm">ML MODEL</div></div>
      <div class="meta-cell"><div class="meta-label">DIFFICULTY</div><div class="meta-val sm">ADAPTIVE</div></div>
    </div>
    <button class="btn-main" onclick="start()">BEGIN TEST</button>
  </div>

  <!-- QUESTION -->
  <div class="screen" id="s1">
    <div class="round-tag" id="rtag">ROUND 1 OF 3</div>
    <div class="q-text" id="qtext">—</div>
    <div class="timer-row">
      <span class="t-label">TIME</span>
      <div class="t-bar"><div class="t-fill" id="tfill" style="width:100%;background:var(--grn)"></div></div>
      <span class="t-val" id="tval" style="color:var(--grn)">—</span>
    </div>
    <div class="feedback" id="fb"></div>
    <input id="ans" placeholder="TYPE YOUR ANSWER…" autocomplete="off" autocorrect="off" spellcheck="false"
      onkeydown="if(event.key==='Enter')submit()">
    <button class="btn-main" id="sbtn" onclick="submit()">SUBMIT</button>
  </div>

  <!-- ROUND SUMMARY -->
  <div class="screen" id="s2">
    <div class="rs-label" id="rslabel">ROUND 1 COMPLETE</div>
    <div class="rs-score" id="rsscore">0/3</div>
    <div class="rs-label">CORRECT</div>
    <ul class="q-list" id="rslist"></ul>
    <button class="btn-main" id="rsnext">NEXT ROUND →</button>
  </div>

  <!-- FINAL -->
  <div class="screen" id="s3">
    <div class="final-wrap">
      <div class="ml-tag">▸ SCORED BY ON-DEVICE ML MODEL</div>
      <div class="score-label">SLEEP SCORE</div>
      <div class="score-big" id="fscore">—</div>
      <div class="verdict" id="fverdict">—</div>
    </div>
    <div class="breakdown" id="fbreakdown"></div>
    <br>
    <button class="btn-main" onclick="start()">TEST AGAIN</button>
  </div>
</div>

<script>
const DC=['d0','d1','d2'],DL=['EASY','MEDIUM','HARD'];
let R=0,Q=0,lim=0,t0=0,tmr=null,results=[[],[],[]],roundCorr=[];
const $=id=>document.getElementById(id);
const show=id=>{document.querySelectorAll('.screen').forEach(s=>s.classList.remove('on'));$(id).classList.add('on');}
const prog=p=>$('prog').style.width=p+'%';
const clr=()=>{clearInterval(tmr);tmr=null;}
const wait=ms=>new Promise(r=>setTimeout(r,ms));
const sc=s=>s>=68?'var(--grn)':s>=40?'var(--amb)':'var(--red)';
const tr=(s,n)=>s.length>n?s.slice(0,n)+'…':s;

async function start(){
  R=0;Q=0;results=[[],[],[]];roundCorr=[];
  prog(0);
  await fetch('/api/start',{method:'POST'});
  await loadQ();show('s1');
}

async function loadQ(){
  clr();
  $('ans').value='';$('ans').className='';$('fb').style.display='none';
  $('sbtn').disabled=false;
  prog(((R*3+Q)/9)*100);
  const d=await fetch('/api/q').then(r=>r.json());
  $('rtag').innerHTML=`ROUND ${R+1} OF 3 <span class="diff ${DC[R]}">${DL[R]}</span> &nbsp;Q${Q+1}/3`;
  $('qtext').textContent=d.q;
  lim=d.ms;
  tick();
  setTimeout(()=>$('ans').focus(),60);
}

function tick(){
  clr();t0=Date.now();
  const fill=$('tfill'),val=$('tval');
  tmr=setInterval(()=>{
    const rem=Math.max(0,lim-(Date.now()-t0)),p=rem/lim*100;
    fill.style.width=p+'%';
    const c=p>50?'var(--grn)':p>22?'var(--amb)':'var(--red)';
    fill.style.background=c;val.style.color=c;
    val.textContent=(rem/1000).toFixed(1)+'s';
    if(!rem){clr();submit(true);}
  },80);
}

async function submit(tout=false){
  clr();
  const elapsed=Date.now()-t0;
  const a=tout?'':$('ans').value.trim();
  $('sbtn').disabled=true;
  const d=await fetch('/api/ans',{
    method:'POST',headers:{'Content-Type':'application/json'},
    body:JSON.stringify({a,ms:elapsed})
  }).then(r=>r.json());
  const fb=$('fb');fb.style.display='block';
  if(d.ok){
    fb.className='feedback f-ok';fb.textContent='✓ CORRECT — '+d.ms+'ms';
    $('ans').classList.add('ok');
  } else {
    fb.className='feedback f-bad';
    fb.textContent=(tout?'✗ TIMED OUT':'✗ WRONG')+' — answer: '+d.ans;
    $('ans').classList.add('bad');
  }
  results[R].push({ok:d.ok,ms:d.ms,q:d.q});
  await wait(1350);
  Q++;
  if(Q>=3){
    roundCorr.push(results[R].filter(x=>x.ok).length);
    showRS();
  } else {
    await loadQ();
  }
}

function showRS(){
  show('s2');
  const corr=roundCorr[R];
  $('rslabel').textContent=`ROUND ${R+1} COMPLETE`;
  const el=$('rsscore');
  el.textContent=corr+'/3';
  el.style.color=corr>=2?'var(--grn)':corr>=1?'var(--amb)':'var(--red)';
  const ul=$('rslist');ul.innerHTML='';
  results[R].forEach(x=>{
    const li=document.createElement('li');
    li.innerHTML=`<span class="q-txt">${tr(x.q,38)}</span><span class="badge ${x.ok?'b-ok':'b-bad'}">${x.ok?'OK':'FAIL'}</span><span class="q-ms">${(x.ms/1000).toFixed(1)}s</span>`;
    ul.appendChild(li);
  });
  prog((R+1)/3*100);
  const nb=$('rsnext');
  if(R+1>=3){nb.textContent='VIEW RESULTS →';nb.onclick=showFinal;}
  else{nb.textContent=`START ROUND ${R+2} →`;nb.onclick=()=>{R++;Q=0;show('s1');loadQ();};}
}

async function showFinal(){
  show('s3');prog(100);
  const d=await fetch('/api/result').then(r=>r.json());
  const s=Math.round(d.score);
  $('fscore').textContent=s;$('fscore').style.color=sc(d.score);
  $('fverdict').textContent=d.verdict;$('fverdict').style.color=sc(d.score);
  $('fbreakdown').innerHTML=`
    <div class="row"><span class="row-label">ROUND 1 (EASY)</span><span class="row-val">${d.acc[0]}/3 correct</span></div>
    <div class="row"><span class="row-label">ROUND 2 (MEDIUM)</span><span class="row-val">${d.acc[1]}/3 correct</span></div>
    <div class="row"><span class="row-label">ROUND 3 (HARD)</span><span class="row-val">${d.acc[2]}/3 correct</span></div>
    <div class="row"><span class="row-label">AVG RESPONSE TIME</span><span class="row-val">${d.avgMs}ms</span></div>
    <div class="row"><span class="row-label">RESPONSE VARIANCE (σ)</span><span class="row-val">${d.variance}ms</span></div>
    <div class="row total"><span class="row-label" style="color:var(--txt)">ML SLEEP SCORE</span>
      <span class="row-val" style="font-size:15px;color:${sc(d.score)}">${d.score.toFixed(1)}</span></div>`;
}
</script>
</body></html>
)HTML";

// ═══════════════════════════════════════════════════════════
//  SESSION LOGIC
// ═══════════════════════════════════════════════════════════
void sesStart() {
  memset(&ses, 0, sizeof(ses));
  ses.active = true;
  for (uint8_t r=0;r<ROUNDS;r++) pickRound(r);
  ses.qStart = millis();
}

void sesAnswer(const String& input) {
  uint32_t ms = millis() - ses.qStart;
  ses.ans[ses.round][ses.qi] = { checkAns(input), ms };
  ses.qi++;
  if (ses.qi >= QS_PER) { ses.round++; ses.qi = 0; }
  if (ses.round >= ROUNDS) { ses.score = runScorer(); ses.done = true; ses.active = false; }
  ses.qStart = millis();
}

// ═══════════════════════════════════════════════════════════
//  API
// ═══════════════════════════════════════════════════════════
void apiStart(AsyncWebServerRequest* req) {
  sesStart();
  req->send(200, "application/json", "{\"ok\":true}");
}

void apiQ(AsyncWebServerRequest* req) {
  const Q& q = curQ();
  String j = "{\"q\":\"" + String(q.text) + "\",\"ms\":" + String(q.budget) + "}";
  req->send(200, "application/json", j);
}

void apiAns(AsyncWebServerRequest* req, uint8_t* data, size_t len, size_t, size_t) {
  String body((char*)data, len);

  // Parse "a" field
  String input = "";
  int ai = body.indexOf("\"a\":\"");
  if (ai >= 0) { int s=ai+5, e=body.indexOf("\"",s); if(e>s) input=body.substring(s,e); }

  bool wasOk   = checkAns(input);
  String qText = String(curQ().text);
  String qAns  = String(curQ().answer);
  uint32_t ms  = millis() - ses.qStart;

  sesAnswer(input);

  String j = "{\"ok\":"  + String(wasOk?"true":"false") +
             ",\"ms\":"  + String(ms) +
             ",\"ans\":\"" + qAns  + "\"" +
             ",\"q\":\""   + qText + "\"}";
  req->send(200, "application/json", j);
}

void apiResult(AsyncWebServerRequest* req) {
  uint8_t acc[3]={};
  double allMs[9]; uint8_t ti=0; double sumMs=0;
  for (uint8_t r=0;r<ROUNDS;r++)
    for (uint8_t q=0;q<QS_PER;q++) {
      if (ses.ans[r][q].ok) acc[r]++;
      allMs[ti]=ses.ans[r][q].ms; sumMs+=allMs[ti++];
    }
  double mean=sumMs/9, var=0;
  for(uint8_t i=0;i<9;i++) var+=(allMs[i]-mean)*(allMs[i]-mean);

  String j = "{\"score\":"   + String(ses.score,1) +
             ",\"verdict\":\"" + String(verdict(ses.score)) + "\"" +
             ",\"acc\":["    + acc[0] + "," + acc[1] + "," + acc[2] + "]" +
             ",\"avgMs\":"   + String((uint32_t)(sumMs/9)) +
             ",\"variance\":" + String((uint32_t)sqrt(var/9.0)) + "}";
  req->send(200, "application/json", j);
}

// ═══════════════════════════════════════════════════════════
//  SETUP / LOOP
// ═══════════════════════════════════════════════════════════
void setup() {
  Serial.begin(115200);
  randomSeed(esp_random());

  // Pure Access Point mode — ESP32-S3 IS the WiFi hotspot
  WiFi.mode(WIFI_AP);
  WiFi.softAP(AP_SSID, AP_PASS);
  delay(500);  // let AP stabilise before anything else

  IPAddress ip = WiFi.softAPIP();
  Serial.println("\n[AP] SSID    : " + String(AP_SSID));
  Serial.println("[AP] Password: " + String(AP_PASS));
  Serial.println("[AP] Open    : http://" + ip.toString());

  server.on("/",          HTTP_GET,  [](AsyncWebServerRequest* r){ r->send_P(200,"text/html",PAGE); });
  server.on("/api/start", HTTP_POST, apiStart);
  server.on("/api/q",     HTTP_GET,  apiQ);
  server.on("/api/ans",   HTTP_POST, [](AsyncWebServerRequest*){}, NULL, apiAns);
  server.on("/api/result",HTTP_GET,  apiResult);
  DefaultHeaders::Instance().addHeader("Access-Control-Allow-Origin","*");
  server.begin();
  Serial.println("[HTTP] ready");
}
void loop(){ delay(10); }
